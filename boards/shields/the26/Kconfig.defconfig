## boards/shields/the26/Kconfig.defconfig
```kconfig
if SHIELD_THE26_LEFT

config ZMK_KEYBOARD_NAME
    default "The 26"

config ZMK_SPLIT_ROLE_CENTRAL
    default y

endif

if SHIELD_THE26_LEFT || SHIELD_THE26_RIGHT

config ZMK_SPLIT
    default y

endif
```

## boards/shields/the26/Kconfig.shield
```kconfig
 config SHIELD_THE26_LEFT
    def_bool $(shields_list_contains,the26_left)

config SHIELD_THE26_RIGHT
    def_bool $(shields_list_contains,the26_right)   def_bool $(shields_list_contains,the26)
```
