#include "the26.dtsi"

&default_transform { 
    col-offset = <5>;
};

&kscan0 {
    col-gpios
        = <&pro_micro 20 GPIO_ACTIVE_HIGH> // col1 in Kicad
        , <&pro_micro 19 GPIO_ACTIVE_HIGH> // col2 in Kicad
        , <&pro_micro 18 GPIO_ACTIVE_HIGH> // col3 in Kicad
        , <&pro_micro 15 GPIO_ACTIVE_HIGH> // col4 in Kicad
        , <&pro_micro 14 GPIO_ACTIVE_HIGH> // col5 in Kicad
        , <&pro_micro 16 GPIO_ACTIVE_HIGH> // col6 in Kicad
        ;
};
